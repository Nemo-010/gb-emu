/*
 * Menu drawing.
 *
 * The font is a 5x7 bitmap drawn one pixel wide, because a 128x64 panel has no
 * room for anything heavier and thin strokes are what read well on an OLED.
 * Only the characters a cartridge name needs are included.
 */

#include <string.h>

#include "menu.h"

/*
 * 5x7 font, ASCII 32 to 127. Each glyph is five column bytes; bit 0 is the top
 * row. Keeping it as columns rather than rows means drawing is a shift per
 * column instead of a transposition per glyph.
 */
static const uint8_t font5x7[96][5] = {
	{0x00,0x00,0x00,0x00,0x00}, /*   */
	{0x00,0x00,0x5f,0x00,0x00}, /* ! */
	{0x00,0x07,0x00,0x07,0x00}, /* " */
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	{0x00,0x00,0x00,0x00,0x00}, /* del */
};

/*
 * The framebuffer is one bit per pixel with the leftmost pixel in bit 7 of each
 * byte, which is what the display layer converts to the panel's page format.
 */
static void put_pixel(uint8_t *fb, int width, int height, int x, int y, bool on)
{
	if (x < 0 || x >= width || y < 0 || y >= height) {
		return;
	}

	size_t idx = (size_t)y * (width / 8) + (x / 8);
	uint8_t mask = 0x80 >> (x & 7);

	if (on) {
		fb[idx] |= mask;
	} else {
		fb[idx] &= ~mask;
	}
}

static void draw_char(uint8_t *fb, int width, int height, int x, int y, char ch,
                      bool invert)
{
	const uint8_t *glyph;
	int col, row;

	if (ch < 32 || ch > 127) {
		ch = '?';
	}
	glyph = font5x7[(int)ch - 32];

	for (col = 0; col < 5; col++) {
		uint8_t bits = glyph[col];

		for (row = 0; row < 7; row++) {
			bool on = (bits >> row) & 1;

			put_pixel(fb, width, height, x + col, y + row, invert ? !on : on);
		}
	}
}

static void draw_text(uint8_t *fb, int width, int height, int x, int y,
                      const char *text, bool invert)
{
	for (int i = 0; text[i] && x + i * 6 < width; i++) {
		draw_char(fb, width, height, x + i * 6, y, text[i], invert);
	}
}

static void fill_rect(uint8_t *fb, int width, int height, int x, int y, int w,
                      int h, bool on)
{
	for (int yy = y; yy < y + h; yy++) {
		for (int xx = x; xx < x + w; xx++) {
			put_pixel(fb, width, height, xx, yy, on);
		}
	}
}

static void draw_hline(uint8_t *fb, int width, int height, int y)
{
	for (int x = 0; x < width; x++) {
		put_pixel(fb, width, height, x, y, true);
	}
}

void menu_init(Menu *menu, const char *title)
{
	memset(menu, 0, sizeof(*menu));
	strncpy(menu->title, title, MENU_TITLE_LEN - 1);
	menu->selected = 0;
	menu->scroll = 0;
}

void menu_clear_items(Menu *menu)
{
	menu->item_count = 0;
	menu->selected = 0;
	menu->scroll = 0;
}

void menu_add_item(Menu *menu, const char *text)
{
	if (menu->item_count >= MENU_MAX_ITEMS) {
		return;
	}

	strncpy(menu->items[menu->item_count], text, MENU_ITEM_LEN - 1);
	menu->items[menu->item_count][MENU_ITEM_LEN - 1] = '\0';
	menu->item_count++;
}

void menu_set_footer(Menu *menu, const char *text)
{
	strncpy(menu->footer, text, sizeof(menu->footer) - 1);
	menu->footer[sizeof(menu->footer) - 1] = '\0';
}

MenuAction menu_button(Menu *menu, uint8_t button, bool pressed)
{
	if (!pressed) {
		return MENU_ACTION_NONE;
	}

	switch (button) {
	case 0x04: /* up */
		if (menu->item_count > 0) {
			if (menu->selected > 0) {
				menu->selected--;
			}
			if (menu->selected < menu->scroll) {
				menu->scroll = menu->selected;
			}
		}
		break;

	case 0x08: /* down */
		if (menu->item_count > 0) {
			if (menu->selected < menu->item_count - 1) {
				menu->selected++;
			}
			if (menu->selected >= menu->scroll + MENU_VISIBLE) {
				menu->scroll = menu->selected - MENU_VISIBLE + 1;
			}
		}
		break;

	case 0x10: /* A: launch */
		if (menu->item_count > 0) {
			return MENU_ACTION_LAUNCH;
		}
		break;

	case 0x20: /* B: nothing in the menu, reserved */
		break;

	default:
		break;
	}

	return MENU_ACTION_NONE;
}

void menu_render(const Menu *menu, uint8_t *fb, int width, int height)
{
	int y;

	memset(fb, 0, (size_t)(width / 8) * height);

	/* Title bar, inverted so it reads as a header. */
	fill_rect(fb, width, height, 0, 0, width, 9, true);
	draw_text(fb, width, height, 2, 1, menu->title, true);
	draw_hline(fb, width, height, 9);

	y = 12;

	if (menu->item_count == 0) {
		draw_text(fb, width, height, 2, y, "no cartridges", false);
	} else {
		for (int i = 0; i < MENU_VISIBLE; i++) {
			int idx = menu->scroll + i;

			if (idx >= menu->item_count) {
				break;
			}

			bool sel = (idx == menu->selected);

			if (sel) {
				fill_rect(fb, width, height, 0, y - 1, width, 9, true);
			}
			draw_text(fb, width, height, 2, y, menu->items[idx], sel);
			y += 9;
		}
	}

	/* Scroll indicator on the right edge. */
	if (menu->item_count > MENU_VISIBLE) {
		int track_top = 12;
		int track_h = MENU_VISIBLE * 9;
		int thumb_h = track_h * MENU_VISIBLE / menu->item_count;
		int thumb_top = track_top +
			(track_h - thumb_h) * menu->scroll /
			(menu->item_count - MENU_VISIBLE);

		fill_rect(fb, width, height, width - 2, thumb_top, 2, thumb_h, true);
	}

	/* Footer, for the card status. */
	draw_hline(fb, width, height, height - 10);
	draw_text(fb, width, height, 2, height - 8, menu->footer, false);
}
